## support/freetz/MY_FILES/make/oscam/Config.in
```kconfig
config FREETZ_PACKAGE_OSCAM
	bool "OSCAM AddOn"
	depends on FREETZ_AVM_HAS_USB_HOST && !FREETZ_TYPE_3370_3490 && !FREETZ_TYPE_3390_3490 && !FREETZ_TYPE_7412_7430
	select FREETZ_PACKAGE_CCID
	select FREETZ_PACKAGE_USBUTILS
	select FREETZ_MODULE_ftdi_sio
	select FREETZ_MODULE_pl2303
	select FREETZ_MODULE_usbserial
	select FREETZ_PATCH_UDEVMOUNT if FREETZ_AVM_VERSION_06_8X_MIN
	select FREETZ_PATCH_MAXDEVCOUNT
	select FREETZ_CUSTOM_UDEV_RULES
	select FREETZ_DROP_NOEXEC_EXTERNAL if FREETZ_AVM_VERSION_06_8X_MIN
	select FREETZ_PATCH_FREETZMOUNT if FREETZ_AVM_VERSION_06_5X_MAX
	select FREETZ_PACKAGE_AVM_PORTFW if FREETZ_AVM_VERSION_06_8X_MIN
	select FREETZ_PACKAGE_AVM_FIREWALL if FREETZ_AVM_VERSION_05_5X_MAX
	select FREETZ_PACKAGE_AVM_FORWARDING if FREETZ_AVM_VERSION_06_0X_MIN && FREETZ_AVM_VERSION_06_5X_MAX
	default n
	help
		Oscam AddOn
```

## support/freetz/MY_FILES/make/pkgs/skin_digital_eliteboard/Config.in
```kconfig
config FREETZ_PACKAGE_SKIN_DIGITAL_ELITEBOARD
	bool "GUI Skin Digital Eliteboard"
	depends on FREETZ_AVM_VERSION_05_5X_MIN
	default n
	help
		Freetz GUI Skin
```

## support/freetz/MY_FILES/make/pkgs/skin_keywelt/Config.in
```kconfig
config FREETZ_PACKAGE_SKIN_KEYWELT
	bool "GUI Skin Keywelt"
	depends on FREETZ_AVM_VERSION_05_5X_MIN
	default n
	help
		Freetz GUI Skin
```

## support/freetz/MY_FILES/make/pkgs/skin_nachtfalke/Config.in
```kconfig
config FREETZ_PACKAGE_SKIN_NACHTFALKE
	bool "GUI Skin Nachtfalke"
	depends on FREETZ_AVM_VERSION_05_5X_MIN
	default n
	help
		Freetz GUI Skin
```

## support/freetz/MY_FILES/make/pkgs/skin_nachtfalke_old/Config.in
```kconfig
config FREETZ_PACKAGE_SKIN_NACHTFALKE_OLD
	bool "GUI Skin Nachtfalke Old"
	depends on FREETZ_AVM_VERSION_05_5X_MIN
	default n
	help
		Freetz GUI Skin
```

## support/freetz/MY_FILES/make/pkgs/skin_prisrak/Config.in
```kconfig
config FREETZ_PACKAGE_SKIN_PRISRAK
	bool "GUI Skin Prisrak"
	depends on FREETZ_AVM_VERSION_05_5X_MIN
	default n
	help
		Freetz GUI Skin
```

## support/freetz/MY_FILES/make/pkgs/skin_prisrak1/Config.in
```kconfig
config FREETZ_PACKAGE_SKIN_PRISRAK1
	bool "GUI Skin Prisrak1"
	depends on FREETZ_AVM_VERSION_05_5X_MIN
	default n
	help
		Freetz GUI Skin
```
